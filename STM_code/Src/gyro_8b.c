/*
 * gyro2.c
 *
 *  Created on: 27 feb. 2018
 *      Author: thomas
 */

#include <gyro_8b.h>
#include "main.h"

uint8_t receivebuffer_8[1];
HAL_StatusTypeDef spi_status;
void gyro_init_transmit(uint8_t buffer_0,uint8_t buffer_1,UART_HandleTypeDef *huart_ptr,SPI_HandleTypeDef *hspi_ptr);
unsigned char reverse_byte(unsigned char x);
/***
 * init function
 */
void gyro_init8b(UART_HandleTypeDef *huart_ptr,SPI_HandleTypeDef *hspi_ptr){
	//reset mpu
	gyro_init_transmit(PWR_MGMT_1,0x80,huart_ptr,hspi_ptr); //reset
	HAL_Delay(100); //delay after reset device
	gyro_init_transmit(PWR_MGMT_1,0x01,huart_ptr,hspi_ptr);
	gyro_init_transmit(PWR_MGMT_2,0x00,huart_ptr,hspi_ptr); //gyro and acc
	gyro_init_transmit(CONFIG,0x00,huart_ptr,hspi_ptr); //standard config
	gyro_init_transmit(GYRO_CONFIG,0x00,huart_ptr,hspi_ptr); //no low pass
	gyro_init_transmit(GYRO_X_OFF,0x00,huart_ptr,hspi_ptr); //regulate x axis offset
	gyro_init_transmit(ACC_CONFIG,0x00,huart_ptr,hspi_ptr);
	gyro_init_transmit(ACC_CONFIG2,0x08,huart_ptr,hspi_ptr);
	gyro_init_transmit(GYRO_Y_OFF,0xC0,huart_ptr,hspi_ptr);
	gyro_init_transmit(INT_PIN_CFG,0x30,huart_ptr,hspi_ptr);
	gyro_init_transmit(USER_CNTRL,0x00,huart_ptr,hspi_ptr); //spi only
	HAL_Delay(250);
	HAL_GPIO_WritePin(LED2_GPIO_Port,LED2_Pin,GPIO_PIN_SET);
}


uint8_t gyro_read(uint8_t type, UART_HandleTypeDef *huart_ptr,SPI_HandleTypeDef *hspi_ptr){
    uint8_t sendbuffer_8[1];
    sendbuffer_8[0]=type;
    sendbuffer_8[1]=0x00;
    HAL_GPIO_WritePin(GPIOB,CS_Pin,GPIO_PIN_RESET);
	spi_status=HAL_SPI_TransmitReceive(hspi_ptr, (uint8_t*)sendbuffer_8, (uint8_t *)receivebuffer_8, 2, 5000);
	if(spi_status==HAL_ERROR) debugPrintln(huart_ptr,"error while init\n\r");
	HAL_GPIO_WritePin(GPIOB,CS_Pin,GPIO_PIN_SET);
	if(spi_status==HAL_OK){
		debugPrintln(huart_ptr, "read");
		intprint8b(huart_ptr, reverse_byte(receivebuffer_8[0]));
		intprint8b(huart_ptr, reverse_byte(receivebuffer_8[1]));
		debugPrintln(huart_ptr, "\n");
	}
return receivebuffer_8[1];
}


void gyro_init_transmit(uint8_t buffer_0,uint8_t buffer_1,UART_HandleTypeDef *huart_ptr,SPI_HandleTypeDef *hspi_ptr){
	uint8_t sendbuffer_8[1];
	sendbuffer_8[0]=buffer_0;
	sendbuffer_8[1]=buffer_1;
	HAL_GPIO_WritePin(GPIOB,CS_Pin,GPIO_PIN_RESET);
	spi_status=HAL_SPI_TransmitReceive(hspi_ptr, (uint8_t*)sendbuffer_8, (uint8_t *)receivebuffer_8, 2, 5000);
	HAL_GPIO_WritePin(GPIOB,CS_Pin,GPIO_PIN_SET);
	if(spi_status==HAL_ERROR) debugPrintln(huart_ptr,"error while gyro init");
}

//whoami returns id
void whoami8b(UART_HandleTypeDef *huart_ptr,SPI_HandleTypeDef *hspi_ptr){
    uint8_t sendbuffer_8[1];//c3
    sendbuffer_8[0]=0xF5;//c3
    sendbuffer_8[1]=0x00;
	HAL_GPIO_WritePin(GPIOB,CS_Pin,GPIO_PIN_RESET);
	spi_status=HAL_SPI_TransmitReceive(hspi_ptr, (uint8_t*)sendbuffer_8, (uint8_t *)receivebuffer_8, 2, 5000);
	if(spi_status==HAL_ERROR) debugPrintln(huart_ptr,"error while reading x");
	HAL_GPIO_WritePin(GPIOB,CS_Pin,GPIO_PIN_SET);

	if(spi_status==HAL_OK){
		debugPrintln(huart_ptr, "whoami");
		intprint8b(huart_ptr, reverse_byte(receivebuffer_8[0]));
		intprint8b(huart_ptr, reverse_byte(receivebuffer_8[1]));
		debugPrintln(huart_ptr, "\n");
	}
}

unsigned char reverse_byte(unsigned char x)
{
    static const unsigned char table[] = {
        0x00, 0x80, 0x40, 0xc0, 0x20, 0xa0, 0x60, 0xe0,
        0x10, 0x90, 0x50, 0xd0, 0x30, 0xb0, 0x70, 0xf0,
        0x08, 0x88, 0x48, 0xc8, 0x28, 0xa8, 0x68, 0xe8,
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        0x1f, 0x9f, 0x5f, 0xdf, 0x3f, 0xbf, 0x7f, 0xff,
    };
    return table[x];
}





